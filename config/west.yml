## config/west.yml
```yaml
manifest:
  remotes:
    - name: zmkfirmware
      url-base: https://github.com/zmkfirmware
    - name: zmkfirmware1
      url-base: https://github.com/petejohanson
  projects:
    - name: zmk
      remote: zmkfirmware1
      revision: zephyr/3.1-upgrade
      import: app/west.yml
  self:
    path: config
```
